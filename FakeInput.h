//-----------------------------------------------------------------------------
// Fake input for ECG and PPG
//-----------------------------------------------------------------------------

#ifdef bFakeInput
//-----------------------------------------------------------------------------
const uint8_t data[] PROGMEM = {
  215, 232, 219, 187, 126, 94, 78, 85, 100, 105, 103, 101, 100, 101, 100, 100, 99, 99, 100, 102, 103,
  103, 103, 102, 102, 103, 105, 106, 106, 106, 107, 109, 112, 113, 115, 117, 121, 122, 123, 123, 126, 129,
  134, 136, 137, 137, 138, 140, 143, 142, 136, 132, 129, 127, 120, 114, 107, 107, 107, 105, 100, 98, 99,
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  109, 108, 107, 106, 105, 105, 105, 106, 107, 106, 101, 97, 94, 98, 120, 148, 204
};

uint8_t getdata(int i) {
  return pgm_read_byte_near(data + i);
}

uint16_t XanalogRead(int pin) {
  static int t = 0;
  #ifdef bHasPPG
    if (pin == PPG_IN) {
      int j,k;
      static float a = 128;
      static float b = 128;
      static float c = 128;
      static float Delay = 35;
      static float dDelay = 0.01;
    
      Delay = Delay + dDelay;
      if (Delay > 40)
        dDelay = -0.0001*random(100);
      if (Delay < 35)
        dDelay = +0.0001*random(100);
    
      if (t == (int)Delay)
        a = 240; else
      if (t == (int)Delay+35)
        a = 200; else
        a = a + (128-a)/20;
      b = b + (a-b)/8;
      c = c + (b-c)/8;
      return c;
    } 
  #endif

  static float Rate = 1;
  static float dRate = 0.001;
  static int i = 0;
  static float f = 0;

  Rate = Rate + dRate;
  if (Rate > 2)
    dRate = -0.00001*random(100);
  if (Rate < 0.8)
    dRate = +0.00001*random(100);

  f = f+Rate;
  i = (int)f % sizeof(data);

  t++;
  if (getdata(i) > 200)
    t = 0;

  return min(getdata(i)*4,1023);
}
#endif
